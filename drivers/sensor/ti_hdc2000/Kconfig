## drivers/sensor/ti_hdc2000/Kconfig
```kconfig
# TI_HDC2000 temperature and humidity sensor configuration options

# Copyright (c) 2020 Statropy Software LLC
# SPDX-License-Identifier: Apache-2.0

config TI_HDC2000
	bool "Texas Instruments Temperature and Humidity Sensor 2000 series (e.g. HDC2010)"
	depends on I2C
	help
	  Enable driver for TI temperature and humidity sensors.
```

## dts/bindings/sensor/ti,hdc2000.yaml
```yaml
# Copyright (c) 2020, Statropy Software LLC
# SPDX-License-Identifier: Apache-2.0

description: Texas Instruments temperature and humidity sensor (e.g. HDC2010)

compatible: "ti,hdc2000"

include: i2c-device.yaml

properties:
    drdy-gpios:
      type: phandle-array
      required: false
      description: Data ready pin.

        The DRDYn pin of HDC2000 sensor is configurable active high or low.
        If connected directly the MCU pin should be configured
        as pull-up or pull-down, respectively.
```
